## ports/esp-idf/examples/ssh_client/main/Kconfig.projbuild
```kconfig
menu "NoxTLS SSH client example"

config NOXTLS_SSH_CLIENT_WIFI_SSID
    string "WiFi SSID"
    default "myssid"

config NOXTLS_SSH_CLIENT_WIFI_PASSWORD
    string "WiFi password"
    default "mypassword"

config NOXTLS_SSH_CLIENT_HOST
    string "SSH host"
    default "192.168.1.10"

config NOXTLS_SSH_CLIENT_PORT
    int "SSH port"
    default 22
    range 1 65535

config NOXTLS_SSH_CLIENT_USERNAME
    string "SSH username"
    default "user"

config NOXTLS_SSH_CLIENT_PASSWORD
    string "SSH password"
    default "password"

config NOXTLS_SSH_CLIENT_COMMAND
    string "Remote command"
    default "uname -a"

config NOXTLS_SSH_CLIENT_ALLOW_UNVERIFIED_HOST
    bool "Send the password without verifying the server host key (testing only)"
    default n
    help
        The example does not check the server host key. With this off (the
        default) it refuses to authenticate, so the configured password is
        never sent to an unverified host. Enable only on a trusted test
        network, or after adding host-key verification to the example.

endmenu
```

## ports/zephyr/tests/crypto_smoke/testcase.yaml
```yaml
tests:
  crypto.noxtls.smoke:
    tags: crypto noxtls
    platform_allow: native_sim qemu_x86 qemu_cortex_m3
    harness: ztest
    timeout: 120
```
