## ports/esp-idf/Kconfig
```kconfig
# SPDX-License-Identifier: Apache-2.0
# ESP-IDF Kconfig for NoxTLS

menuconfig NOXTLS
	bool "NoxTLS cryptography and TLS library"
	default n
	help
	  Enable the NoxTLS library from Argenox. Add this component via
	  EXTRA_COMPONENT_DIRS pointing at ports/esp-idf (see ports/esp-idf/README.md).

if NOXTLS

choice NOXTLS_PROFILE
	prompt "Feature profile"
	default NOXTLS_PROFILE_DEFAULT
	help
	  Predefined feature sets matching noxtls/CMakeLists.txt profiles.
	  For full control over every NOXTLS_FEATURE_* option in menuconfig,
	  select profile "default". Other profiles override many options at
	  build time regardless of individual Kconfig toggles.

config NOXTLS_PROFILE_DEFAULT
	bool "default"

config NOXTLS_PROFILE_MINIMAL_TLS_CLIENT
	bool "minimal_tls_client"

config NOXTLS_PROFILE_TLS_SERVER_PKI
	bool "tls_server_pki"

config NOXTLS_PROFILE_CRYPTO_ONLY
	bool "crypto_only"

config NOXTLS_PROFILE_FIPS_LIKE
	bool "fips_like_profile"

endchoice

config NOXTLS_PROFILE
	string
	default "minimal_tls_client" if NOXTLS_PROFILE_MINIMAL_TLS_CLIENT
	default "tls_server_pki" if NOXTLS_PROFILE_TLS_SERVER_PKI
	default "crypto_only" if NOXTLS_PROFILE_CRYPTO_ONLY
	default "fips_like_profile" if NOXTLS_PROFILE_FIPS_LIKE
	default "default"

choice NOXTLS_SIDECHANNEL
	prompt "Side-channel profile"
	default NOXTLS_SIDECHANNEL_BALANCED
	help
	  Maps to NOXTLS_SIDECHANNEL_PROFILE_* and NOXTLS_CT_COMPARE in
	  noxtls_config.h (CT compare is off only for "performance").

config NOXTLS_SIDECHANNEL_PERFORMANCE
	bool "performance"

config NOXTLS_SIDECHANNEL_BALANCED
	bool "balanced"

config NOXTLS_SIDECHANNEL_CONSTANT_TIME_STRICT
	bool "constant_time_strict"

endchoice

config NOXTLS_SIDECHANNEL
	string
	default "performance" if NOXTLS_SIDECHANNEL_PERFORMANCE
	default "constant_time_strict" if NOXTLS_SIDECHANNEL_CONSTANT_TIME_STRICT
	default "balanced"

config NOXTLS_USE_ESP_ENTROPY
	bool "Seed DRBG from ESP hardware RNG (esp_fill_random)"
	default y
	depends on NOXTLS_FEATURE_DRBG
	help
	  Registers esp_fill_random() with noxtls_drbg_set_entropy_callback()
	  during component init (constructor or noxtls_esp_idf_init()).

menu "ESP Hardware Crypto Acceleration"

config NOXTLS_ESP_HW_ECC
	bool "Use ESP hardware ECC point multiplication (P-256 when supported)"
	default y
	depends on NOXTLS_FEATURE_ECC && SOC_ECC_SUPPORTED
	help
	  Enables ECC scalar multiplication offload through ESP-IDF HAL when the
	  selected target provides ECC hardware (SOC_ECC_SUPPORTED). Targets
	  without ECC hardware automatically fall back to software.

config NOXTLS_ESP_HW_ECDSA
	bool "Use ESP hardware ECC path for ECDSA P-256 operations"
	default y
	depends on NOXTLS_FEATURE_ECDSA && NOXTLS_FEATURE_ECC && SOC_ECC_SUPPORTED
	help
	  Enables use of the ECC hardware scalar multiply path for ECDSA sign and
	  verify operations when available. If disabled, ECDSA uses software ECC.

config NOXTLS_ESP_HW_MPI
	bool "Use ESP hardware MPI for P-256 bignum (mod, mod_exp)"
	default y
	depends on NOXTLS_FEATURE_PKC
	help
	  Registers NoxTLS bignum hooks that call the ESP-IDF MPI implementation
	  (PKC peripheral via esp_bignum). Speeds ECDSA modular inverse and field
	  reduction. Also enable mbedTLS "Use hardware MPI" in Component config.

config NOXTLS_ESP_HW_AES
	bool "Use ESP hardware AES backend"
	default y
	depends on NOXTLS_FEATURE_AES && SOC_AES_SUPPORTED
	help
	  Enables AES block offload through ESP-IDF HAL (esp_aes_*). Targets
	  without hardware AES support automatically fall back to software.

config NOXTLS_ESP_HW_SHA
	bool "Use ESP hardware SHA backend (SHA-224/256)"
	default y
	depends on (NOXTLS_FEATURE_SHA224 || NOXTLS_FEATURE_SHA256) && SOC_SHA_SUPPORTED
	help
	  Enables SHA-224/SHA-256 block processing through ESP-IDF SHA HAL when
	  available. Targets without SHA hardware support use software fallback.

endmenu

config NOXTLS_SAMPLE_TLS_CONNECT
	bool "TLS client sample: perform network handshake"
	default n
	help
	  When enabled, the tls_client example opens a TCP connection and runs a
	  TLS 1.3 handshake. Leave disabled for init-only smoke testing.

config NOXTLS_SAMPLE_TLS_HOST
	string "TLS client sample hostname"
	default "example.com"
	depends on NOXTLS_SAMPLE_TLS_CONNECT

rsource "Kconfig.noxtls.generated"

endif # NOXTLS
```

## ports/esp-idf/examples/benchmark/main/Kconfig.projbuild
```kconfig
menu "NoxTLS benchmark example"

config NOXTLS_BENCH_BUFFER_SIZE
	int "Symmetric primitive buffer size (bytes)"
	default 4096
	range 256 65536
	help
	  Size of the plaintext / hash input buffer used for symmetric
	  throughput benchmarks (SHA-256, AES-GCM, ChaCha20-Poly1305).

config NOXTLS_BENCH_THROUGHPUT_ITERATIONS
	int "Symmetric throughput iterations"
	default 256
	range 1 1000000
	help
	  Number of buffer-sized operations performed in each throughput
	  measurement. Total bytes processed = buffer * iterations.

config NOXTLS_BENCH_DRBG_ITERATIONS
	int "DRBG generate iterations"
	default 256
	range 1 1000000

config NOXTLS_BENCH_PKC_ITERATIONS
	int "Public-key operation iterations (ECDSA sign / verify)"
	default 16
	range 1 1024

config NOXTLS_BENCH_RUN_ECDSA
	bool "Run ECDSA P-256 benchmark"
	default y
	depends on NOXTLS_FEATURE_ECDSA

endmenu
```

## ports/esp-idf/examples/benchmark/sdkconfig.defaults
```kconfig
CONFIG_NOXTLS=y
CONFIG_NOXTLS_PROFILE_DEFAULT=y
CONFIG_NOXTLS_USE_ESP_ENTROPY=y

CONFIG_NOXTLS_FEATURE_AES=y
CONFIG_NOXTLS_FEATURE_AES_128=y
CONFIG_NOXTLS_FEATURE_AES_256=y
CONFIG_NOXTLS_FEATURE_AES_GCM=y
CONFIG_NOXTLS_FEATURE_CHACHA20_POLY1305=y
CONFIG_NOXTLS_FEATURE_SHA256=y
CONFIG_NOXTLS_FEATURE_SHA384=y
CONFIG_NOXTLS_FEATURE_DRBG=y
CONFIG_NOXTLS_FEATURE_PKC=y
CONFIG_NOXTLS_FEATURE_ECC=y
CONFIG_NOXTLS_FEATURE_ECDSA=y
CONFIG_NOXTLS_FEATURE_CERT=y
CONFIG_NOXTLS_FEATURE_TLS=y
CONFIG_NOXTLS_FEATURE_TLS12=y
CONFIG_NOXTLS_FEATURE_TLS13=y

CONFIG_ESP_MAIN_TASK_STACK_SIZE=12288
CONFIG_COMPILER_OPTIMIZATION_PERF=y
CONFIG_ESP_TASK_WDT_EN=n
CONFIG_ESP_TASK_WDT_INIT=n
CONFIG_ESP_TASK_WDT_CHECK_IDLE_TASK_CPU0=n
CONFIG_ESP_TASK_WDT_CHECK_IDLE_TASK_CPU1=n
```

## ports/esp-idf/examples/https_file_client/main/Kconfig.projbuild
```kconfig
menu "NoxTLS HTTPS file client example"

config NOXTLS_FILE_CLIENT_WIFI_SSID
    string "WiFi SSID"
    default "myssid"

config NOXTLS_FILE_CLIENT_WIFI_PASSWORD
    string "WiFi password"
    default "mypassword"

config NOXTLS_FILE_CLIENT_HOST
    string "HTTPS host"
    default "example.com"

config NOXTLS_FILE_CLIENT_PORT
    int "HTTPS port"
    default 443
    range 1 65535

config NOXTLS_FILE_CLIENT_PATH
    string "HTTP path to retrieve"
    default "/"

config NOXTLS_FILE_CLIENT_OUTPUT_PATH
    string "Destination path in SPIFFS"
    default "/spiffs/download.bin"

config NOXTLS_FILE_CLIENT_MAX_DOWNLOAD_BYTES
    int "Maximum body bytes to store"
    default 262144
    range 1024 4194304

endmenu
```

## ports/esp-idf/examples/https_file_client/sdkconfig.defaults
```kconfig
CONFIG_NOXTLS=y
CONFIG_NOXTLS_PROFILE_DEFAULT=y
CONFIG_NOXTLS_USE_ESP_ENTROPY=y

CONFIG_NOXTLS_FEATURE_TLS=y
CONFIG_NOXTLS_FEATURE_TLS13=y
CONFIG_NOXTLS_FEATURE_CERT=y
CONFIG_NOXTLS_FEATURE_ECC=y
CONFIG_NOXTLS_FEATURE_ECDSA=y
CONFIG_NOXTLS_FEATURE_SHA256=y

CONFIG_ESP_MAIN_TASK_STACK_SIZE=24576
CONFIG_COMPILER_OPTIMIZATION_PERF=y

CONFIG_PARTITION_TABLE_CUSTOM=y
CONFIG_PARTITION_TABLE_CUSTOM_FILENAME="partitions.csv"
CONFIG_PARTITION_TABLE_FILENAME="partitions.csv"
CONFIG_ESPTOOLPY_FLASHSIZE_8MB=y
CONFIG_ESPTOOLPY_FLASHSIZE="8MB"

CONFIG_SPIFFS_USE_MTIME=y
```

## ports/esp-idf/examples/https_server/main/Kconfig.projbuild
```kconfig
menu "NoxTLS HTTPS server example"

config NOXTLS_HTTPS_SERVER_PORT
	int "HTTPS listen port"
	default 8443
	range 1 65535
	help
	  TCP port the example HTTPS server listens on.

config NOXTLS_HTTPS_SERVER_WIFI_SSID
	string "WiFi SSID"
	default "myssid"
	help
	  SSID (network name) of the WiFi access point.

config NOXTLS_HTTPS_SERVER_WIFI_PASSWORD
	string "WiFi password"
	default "mypassword"
	help
	  WiFi password (WPA/WPA2). Leave empty for open networks.

config NOXTLS_HTTPS_SERVER_USE_WIFI
	bool "Connect to WiFi at startup"
	default y
	help
	  When enabled, the example connects to the configured WiFi SSID
	  before opening the HTTPS listener. Disable for Ethernet, manual
	  bring-up, or for testing on the loopback interface only.

config NOXTLS_HTTPS_SERVER_BACKLOG
	int "Max pending TCP backlog"
	default 1
	range 1 8

config NOXTLS_HTTPS_SERVER_LOG_WIFI_PASSWORD
	bool "Log WiFi password in plaintext on startup"
	default n
	depends on NOXTLS_HTTPS_SERVER_USE_WIFI
	help
	  When enabled, the example logs the configured WiFi password on
	  startup along with the SSID. Useful for local debugging only.
	  Leave disabled in production; the SSID and password length are
	  still logged so you can confirm the values were configured.

config NOXTLS_HTTPS_SERVER_HANDSHAKE_DEBUG
	bool "Verbose NoxTLS handshake logging (UART)"
	default n
	help
	  Enables NoxTLS [TLS_DEBUG] printf during noxtls_tls13_accept (which
	  step failed, ECDSA progress, etc.). Noisy and slower; use only while
	  debugging handshake failures.

endmenu
```

## ports/esp-idf/examples/https_server/sdkconfig.defaults
```kconfig
CONFIG_NOXTLS=y
# Use the "default" profile here. The "tls_server_pki" profile would disable
# SHA1/MD5/DH/AES-CCM, but the library still references those symbols from
# runtime-selected branches in noxtls_tls_kdf.c, noxtls_tls13.c, noxtls_tls_record.c,
# and noxtls_rsa.c, which produces undefined-reference errors at link time.
# Switch back to CONFIG_NOXTLS_PROFILE_TLS_SERVER_PKI=y once the library's
# call sites are gated with #if NOXTLS_FEATURE_* in addition to runtime checks.
CONFIG_NOXTLS_PROFILE_DEFAULT=y
CONFIG_NOXTLS_USE_ESP_ENTROPY=y

# NoxTLS ESP hardware crypto (see ports/esp-idf/Kconfig and README.md).
# HW AES/SHA/ECC/ECDSA defaults are target-specific (Kconfig depends on SOC_*).
# Do not force CONFIG_NOXTLS_ESP_HW_AES or CONFIG_MBEDTLS_HARDWARE_AES here — chips
# without AES (e.g. esp32h2, esp32c2) fail to build if those are pinned in defaults.
# MPI is available on all listed targets; enable it explicitly for ECDSA performance.
CONFIG_NOXTLS_ESP_HW_MPI=y
CONFIG_MBEDTLS_HARDWARE_MPI=y

# TCP-only HTTPS: no DTLS/UDP (links noxtls_dtls_stub.c, skips record_send_buf at init).
# CONFIG_NOXTLS_FEATURE_DTLS is not set

# Main task stack (tls13_context_t is heap-allocated; stack still needs headroom for Wi-Fi/TCP).
CONFIG_ESP_MAIN_TASK_STACK_SIZE=24576

# ECDSA P-256 CertificateVerify can take several seconds on CPU; default 5s WDT fires first.
CONFIG_ESP_TASK_WDT_TIMEOUT_S=30

# Release-style build: NDEBUG silences noxtls_debug_printf in crypto hot paths.
# Crypto hot paths benefit from -O2; size build made ECDSA ~4x slower on ESP32.
CONFIG_COMPILER_OPTIMIZATION_PERF=y
CONFIG_COMPILER_OPTIMIZATION_ASSERTIONS_DISABLE=y

# TLS record buffers: default 16 KiB needs ~57 KiB heap per connection on ESP32.
CONFIG_NOXTLS_TLS_MAX_RECORD_SIZE=4096
CONFIG_NOXTLS_TLS_MAX_WIRE_RECORD_LENGTH=4608
CONFIG_NOXTLS_TLS_MAX_HANDSHAKE_SIZE=8192
CONFIG_NOXTLS_MAX_CERT_SIZE=4096

# Networking
CONFIG_LWIP_MAX_SOCKETS=8

# Console output
CONFIG_ESP_CONSOLE_UART_DEFAULT=y

CONFIG_NOXTLS_HTTPS_SERVER_WIFI_SSID="myssid"
CONFIG_NOXTLS_HTTPS_SERVER_WIFI_PASSWORD="mypassword"
```

## ports/esp-idf/examples/secure_ota/main/Kconfig.projbuild
```kconfig
menu "NoxTLS secure OTA example"

config NOXTLS_SECURE_OTA_WIFI_SSID
    string "WiFi SSID"
    default "myssid"

config NOXTLS_SECURE_OTA_WIFI_PASSWORD
    string "WiFi password"
    default "mypassword"

config NOXTLS_SECURE_OTA_HOST
    string "HTTPS host"
    default "example.com"

config NOXTLS_SECURE_OTA_PORT
    int "HTTPS port"
    default 443
    range 1 65535

config NOXTLS_SECURE_OTA_PATH
    string "Firmware path"
    default "/firmware.bin"

config NOXTLS_SECURE_OTA_MAX_IMAGE_BYTES
    int "Max firmware bytes"
    default 2097152
    range 65536 8388608

config NOXTLS_SECURE_OTA_EXPECTED_SHA256_HEX
    string "Expected firmware SHA-256 (64 hex chars, optional)"
    default ""

endmenu
```

## ports/esp-idf/examples/sftp_client/main/Kconfig.projbuild
```kconfig
menu "NoxTLS SFTP client example"

config NOXTLS_SFTP_REMOTE_PATH
    string "Remote path"
    default "/tmp/file.bin"

endmenu
```

## ports/esp-idf/examples/ssh_client/sdkconfig.defaults
```kconfig
CONFIG_NOXTLS=y
CONFIG_NOXTLS_PROFILE_DEFAULT=y
CONFIG_NOXTLS_USE_ESP_ENTROPY=y

CONFIG_NOXTLS_FEATURE_TLS=n
CONFIG_NOXTLS_FEATURE_TLS12=n
CONFIG_NOXTLS_FEATURE_TLS13=n
CONFIG_NOXTLS_FEATURE_CERT=n

CONFIG_ESP_MAIN_TASK_STACK_SIZE=24576
CONFIG_COMPILER_OPTIMIZATION_PERF=y
```

## ports/esp-idf/examples/ssh_server/main/Kconfig.projbuild
```kconfig
menu "NoxTLS SSH server example"

config NOXTLS_SSH_SERVER_PORT
    int "SSH listen port"
    default 22
    range 1 65535

endmenu
```

## ports/esp-idf/examples/tls_client/sdkconfig.defaults
```kconfig
CONFIG_NOXTLS=y
CONFIG_NOXTLS_PROFILE_MINIMAL_TLS_CLIENT=y
CONFIG_NOXTLS_USE_ESP_ENTROPY=y

# Leave disabled for init-only smoke testing; set y for a live TLS handshake.
# CONFIG_NOXTLS_SAMPLE_TLS_CONNECT=y
# CONFIG_NOXTLS_SAMPLE_TLS_HOST="example.com"
```
